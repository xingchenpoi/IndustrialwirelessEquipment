/*******************************************************************************
**              广州中科院沈阳自动化研究所分所 Copyright (c)
**                     物联网技术与应用研发中心
**                        IM(2019-2022)
** 作    者：
** 日    期：
** 文件名称：
** 摘    要：

*******************************************************************************/
/*--------------------------------- 头文件 -----------------------------------*/
#include "APP_Di.h"  

/*-------------------------------- 全局变量 ----------------------------------*/
#define DI_INTERVAL   200           //DI查询间隔



/*******************************************************************************
** 函数原型：void DO_Reboot_Sta_Get(DO_TypeDef *p)
** 函数功能：DO上电状态获取
** 输入参数：p   DO结构体首地址
** 输出参数：无
** 备    注：


*******************************************************************************/
void DI_Sta_Get(DI_TypeDef *p)
{
	p->rt_sta[0] = DI0_READ;
	p->rt_sta[1] = DI1_READ;
	p->rt_sta[2] = DI2_READ;
	p->rt_sta[3] = DI3_READ;
}



/*******************************************************************************
** 函数原型：void DO_Reboot_Sta_Get(DO_TypeDef *p)
** 函数功能：DO上电状态获取
** 输入参数：p   DO结构体首地址
** 输出参数：无
** 备    注：


*******************************************************************************/
void DI_Pulse_Count(DI_TypeDef *p, eDI_CHL chl)
{
	p->pulse_cnt[chl]++;
}





/*******************************************************************************
** 函数原型：void HAL_GPIO_EXTI_Callback(uint16_t GPIO_Pin)
** 函数功能：外部中断回调函数
** 输入参数：GPIO_Pin 中断引脚
** 输出参数：无
** 备    注：

*******************************************************************************/
void HAL_GPIO_EXTI_Callback(uint16_t GPIO_Pin)
{
	switch (GPIO_Pin)
	{
		case DI0_PIN:
			DI_Pulse_Count(&dev_di, DI_CHL0);
			break;

		case DI1_PIN:
			DI_Pulse_Count(&dev_di, DI_CHL1);
			break;

		case DI2_PIN:
			DI_Pulse_Count(&dev_di, DI_CHL2);
			break;

		case DI3_PIN:
			DI_Pulse_Count(&dev_di, DI_CHL3);
			break;

		default:
			break;
	}

}





/*******************************************************************************
** 函数原型：void DI_Lanuch(void)
** 函数功能：DI处理入口
** 输入参数：无
** 输出参数：无
** 备    注：


*******************************************************************************/
void DI_Lanuch(void)
{
    uint8_t i = 0;
    
	if (APP_TIM_ReadDecounterValue(TIM_DI_INTERVAL) != 0)
		return;

	APP_TIM_StartDecounter(TIM_DI_INTERVAL, DI_INTERVAL);

    DI_Sta_Get(&dev_di);       //获取当前DI值
    
    for(i=0;i<4;i++)
    {
		DO_Ctrl(&dev_do,i, dev_di.rt_sta[i]);
    }   
}




/*******************************************************************************
*    测试日期           测试人            测试结果          处理结果
*
*******************************************************************************/





